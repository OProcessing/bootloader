# file: bootFW.ioc
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Mcu.Family=STM32F4
Mcu.Name=STM32F446R(C-E)Tx
Mcu.Package=LQFP64
NVIC.PriorityGroup=NVIC_PRIORITYGROUP_4
ProjectManager.HeapSize=0x200
ProjectManager.StackSize=0x400
ProjectManager.TargetToolchain=STM32CubeIDE
RCC.CortexFreq_Value=16000000
RCC.USBFreq_Value=96000000
RCC.VCOOutputFreq_Value=192000000
board=custom

// file: Core/Src/main.c
/* USER CODE BEGIN Header */
/**
  ******************************************************************************
  * @file           : main.c
  * @brief          : Main program body
  ******************************************************************************
  * @attention
  *
  * Copyright (c) 2026 STMicroelectronics.
  * All rights reserved.
  *
  * This software is licensed under terms that can be found in the LICENSE file
  * in the root directory of this software component.
  * If no LICENSE file comes with this software, it is provided AS-IS.
  *
  ******************************************************************************
  */
/* USER CODE END Header */
#include "main.h"

/* USER CODE BEGIN Includes */
#include "../../../Shared/boot_state.h"
#include "../../../Shared/boot_watchdog.h"
#include "../../../Shared/boot_protection.h"
/* USER CODE END Includes */

/* USER CODE BEGIN PD */
#define APP_ADDR       BOOT_APP_ADDR
#define APP_END_ADDR   BOOT_APP_END
#define SRAM_START     0x20000000UL
#define SRAM_END       0x20020000UL
/* USER CODE END PD */

/* USER CODE BEGIN PV */
/* Inspect these variables in the debugger when recovery mode is entered. */
volatile uint32_t boot_reset_flags;
volatile uint32_t boot_reset_causes;
volatile BootResult boot_result;
BootMetadata boot_metadata;
volatile uint32_t boot_recovery_mode;
volatile BootProtectionResult boot_protection_result;
/* USER CODE END PV */

void SystemClock_Config(void);
void JumpToApp(void);

int main(void)
{

  /* USER CODE BEGIN 1 */
  /* Preserve all reset flags before clearing them for the next boot. */
  boot_reset_flags = RCC->CSR;
  boot_reset_causes = Boot_DecodeReset(boot_reset_flags);
  __HAL_RCC_CLEAR_RESET_FLAGS();
  /* USER CODE END 1 */

  /* MCU Configuration--------------------------------------------------------*/

  /* Reset of all peripherals, Initializes the Flash interface and the Systick. */
  HAL_Init();

  /* Configure the system clock */
  SystemClock_Config();

  /* Initialize all configured peripherals */
  /* USER CODE BEGIN 2 */
  boot_protection_result = Boot_ProtectBootloader();
  boot_result = BOOT_BAD_STATE;
  if (boot_protection_result == BOOT_PROTECTION_OK)
  {
    boot_result = Boot_Prepare(boot_reset_flags, &boot_metadata);
  }
  if (boot_result == BOOT_SUCCESS)
  {
    JumpToApp();
  }
  /* Recovery policy for stage 3: remain in the bootloader's main loop. */
  boot_recovery_mode = 1U;
  /* USER CODE END 2 */

  /* Infinite loop */
  while (1)
  {

    /* USER CODE BEGIN 3 */
    /* Safe even if software-start IWDG has not been started. Do not jump again
     * until a future explicit recovery action registers a verified image. */
    Boot_WatchdogFeed();
    HAL_Delay(10U);
  }
  /* USER CODE END 3 */
}

void SystemClock_Config(void)
{
  RCC_OscInitTypeDef RCC_OscInitStruct = {0};
  RCC_ClkInitTypeDef RCC_ClkInitStruct = {0};

  /** Configure the main internal regulator output voltage
  */
  __HAL_RCC_PWR_CLK_ENABLE();
  __HAL_PWR_VOLTAGESCALING_CONFIG(PWR_REGULATOR_VOLTAGE_SCALE3);

  /** Initializes the RCC Oscillators according to the specified parameters
  * in the RCC_OscInitTypeDef structure.
  */
  RCC_OscInitStruct.OscillatorType = RCC_OSCILLATORTYPE_HSI;
  RCC_OscInitStruct.HSIState = RCC_HSI_ON;
  RCC_OscInitStruct.HSICalibrationValue = RCC_HSICALIBRATION_DEFAULT;
  RCC_OscInitStruct.PLL.PLLState = RCC_PLL_NONE;
  if (HAL_RCC_OscConfig(&RCC_OscInitStruct) != HAL_OK)
  {
    Error_Handler();
  }

  /** Initializes the CPU, AHB and APB buses clocks
  */
  RCC_ClkInitStruct.ClockType = RCC_CLOCKTYPE_HCLK|RCC_CLOCKTYPE_SYSCLK
                              |RCC_CLOCKTYPE_PCLK1|RCC_CLOCKTYPE_PCLK2;
  RCC_ClkInitStruct.SYSCLKSource = RCC_SYSCLKSOURCE_HSI;
  RCC_ClkInitStruct.AHBCLKDivider = RCC_SYSCLK_DIV1;
  RCC_ClkInitStruct.APB1CLKDivider = RCC_HCLK_DIV1;
  RCC_ClkInitStruct.APB2CLKDivider = RCC_HCLK_DIV1;

  if (HAL_RCC_ClockConfig(&RCC_ClkInitStruct, FLASH_LATENCY_0) != HAL_OK)
  {
    Error_Handler();
  }
}

/* USER CODE BEGIN 4 */
/* AAPCS: arguments arrive in r0/r1. No C/stack access after MSP changes. */
__attribute__((naked, noreturn))
static void BranchToApp(uint32_t sp __attribute__((unused)),
                        uint32_t pc __attribute__((unused)))
{
    __asm volatile (
        "msr msp, r0\n"
        "movs r2, #0\n"
        "msr control, r2\n"
        "isb\n"
        "bx r1\n"
    );
}

void JumpToApp(void)
{
    uint32_t sp = *(volatile uint32_t *)APP_ADDR;
    uint32_t pc = *(volatile uint32_t *)(APP_ADDR + 4U);
    uint32_t reset_addr = pc & ~1UL;

    if ((sp <= SRAM_START) || (sp > SRAM_END) || ((sp & 7U) != 0U) ||
        ((pc & 1U) == 0U) || (reset_addr < APP_ADDR) || (reset_addr >= APP_END_ADDR))
    {
        boot_result = BOOT_BAD_IMAGE;
        return;
    }

    /* Cover App Reset_Handler and initialization, not only its main loop. */
    if (!Boot_WatchdogStart())
    {
        boot_result = BOOT_WATCHDOG_ERROR;
        return;
    }

    /* All metadata writes finish with interrupts enabled before this point. */
    __disable_irq();
    SysTick->CTRL = 0U;
    SysTick->LOAD = 0U;
    SysTick->VAL = 0U;
    HAL_DeInit();
    for (uint32_t i = 0U; i < 8U; ++i)
    {
        NVIC->ICER[i] = UINT32_MAX;
        NVIC->ICPR[i] = UINT32_MAX;
    }
    SCB->ICSR = SCB_ICSR_PENDSTCLR_Msk | SCB_ICSR_PENDSVCLR_Msk;
    SCB->VTOR = APP_ADDR;
    __DSB();
    __ISB();
    BranchToApp(sp, pc);
}
/* USER CODE END 4 */

void Error_Handler(void)
{
  __disable_irq();
  while (1)
  {
  }
}
